## config/west.yml
```yaml
manifest:
  remotes:
    - name: cormoran
    # ← zmkfirmware ではなく cormoran
      url-base: https://github.com/cormoran
#    - name: inorichi
#      url-base: https://github.com/inorichi
    - name: H1r0k1kun
      url-base: https://github.com/H1r0k1kun
    - name: keyfreaks
      url-base: https://github.com/kay-yokoyama
    - name: caksoylar
      url-base: https://github.com/caksoylar
    - name: prospector
      url-base: https://github.com/t-ogura
    - name: kot149
      url-base: https://github.com/kot149
    - name: cormoran
      url-base: https://github.com/cormoran
  projects:
    - name: zmk
      remote: cormoran 
# ← zmkfirmware ではなく cormoran
#      revision: v0.2.1
#     import: app/west.yml
      revision: v0.3-branch+dya
      import: app/west.yml
#    - name: zmk-pmw3610-driver
#      remote: inorichi
#      revision: main
    - name: zmk-pmw3610-driver
      remote: H1r0k1kun
      revision: main
    - name: zmk-rgbled-widget
      remote: caksoylar
      revision: v0.3-branch
    - name: prospector-zmk-module
      remote: prospector
      revision: v1.0.0
      path: modules/prospector-zmk-module
    - name: zmk-scroll-snap
      remote: kot149
      revision: v1
    - name: zmk-mouse-gesture
      remote: kot149
      revision: v1
    - name: zmk-module-ble-management
      remote: cormoran
      revision: main
    - name: zmk-module-battery-history
      remote: cormoran
      revision: main
    - name: zmk-module-settings-rpc
      remote: cormoran
      revision: main
    - name: zmk-module-runtime-input-processor
      remote: cormoran
      revision: main
  self:
    path: config
```
