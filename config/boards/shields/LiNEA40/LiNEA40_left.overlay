#include "LiNEA40.dtsi"

&kscan0 {
    col-gpios
        = <&xiao_d 10 GPIO_ACTIVE_HIGH> //col0-D10
        , <&xiao_d 9 GPIO_ACTIVE_HIGH>  //col1-D9
        , <&xiao_d 8 GPIO_ACTIVE_HIGH>  //col2-D8
        , <&xiao_d 7 GPIO_ACTIVE_HIGH>  //col3-D7
        , <&gpio0 10 GPIO_ACTIVE_HIGH>  //col4-NFC2
        , <&gpio0 9 GPIO_ACTIVE_HIGH>   //col5-NFC1
        ;
};

/*
 * ロータリーエンコーダは物理的に取り外し済み（全てキーに変更）。
 * 有効のままだと実体のない EC11 ドライバが D5/D6 をプルアップで握り続けるため、
 * LiNEA40.dtsi の既定（status = "disabled"）のままにする。
 *
 * 右手側も同じく disabled で正常にビルドできているので、
 * キーマップに残っている sensor-bindings は不活性になるだけで問題ない。
 *
 * エンコーダを戻す場合はここで status = "okay" に上書きする。
 */
